/ {
    right_encoder: encoder_right {
        compatible = "alps,ec11";
        label = "RIGHT_ENCODER";
        // Standard Lily58 encoder pins mapped via the nice!nano's pro_micro labels
        a-gpios = <&pro_micro 21 (GPIO_ACTIVE_HIGH | GPIO_PULL_UP)>;
        b-gpios = <&pro_micro 20 (GPIO_ACTIVE_HIGH | GPIO_PULL_UP)>;
        steps = <80>;
    };

    sensors {
        compatible = "zmk,keymap-sensors";
        sensors = <&right_encoder>;
        triggers-per-rotation = <20>;
    };
};